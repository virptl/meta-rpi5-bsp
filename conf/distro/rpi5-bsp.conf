## conf/distro/rpi5-bsp.conf
```bitbake
# RPi5 BSP distribution

# Base everything on poky
require conf/distro/poky.conf

DISTRO = "rpi5-bsp"
DISTRO_NAME = "RPi5 BSP Distribution"
DISTRO_VERSION = "1.0"

# Base everything on poky (still safe, but no warning)
DISTRO_FEATURES_BACKFILL_CONSIDERED += "sysvinit"

# Make builds deterministic
PACKAGE_CLASSES ?= "package_rpm"
```

## conf/layer.conf
```bitbake
# Add this layer to BBPATH
BBPATH .= ":${LAYERDIR}"

# Add all recipes and bbappends from this layer
BBFILES += "${LAYERDIR}/recipes-*/*/*.bb \
            ${LAYERDIR}/recipes-*/*/*.bbappend"

# Layer identification
BBFILE_COLLECTIONS += "meta-rpi5-bsp"
BBFILE_PATTERN_meta-rpi5-bsp = "^${LAYERDIR}/"
BBFILE_PRIORITY_meta-rpi5-bsp = "6"

# Layer dependencies
LAYERDEPENDS_meta-rpi5-bsp = "core"

# Compatible Yocto release series
LAYERSERIES_COMPAT_meta-rpi5-bsp = "scarthgap"
```

## conf/machine/rpi5-bsp.conf
```bitbake
# -----------------------------------------------------------------------------
# Custom Raspberry Pi 5 BSP Machine
# -----------------------------------------------------------------------------

#@TYPE: Machine
#@NAME: rpi5-bsp
#@DESCRIPTION: Raspberry Pi 5 BSP focused on stable boot and debug access

# -----------------------------------------------------------------------------
# Firmware licensing (Raspberry Pi Wi-Fi / BT)
# -----------------------------------------------------------------------------
LICENSE_FLAGS_ACCEPTED += "synaptics-killswitch"

# -----------------------------------------------------------------------------
# Base machine
# -----------------------------------------------------------------------------
require conf/machine/raspberrypi5.conf

# -----------------------------------------------------------------------------
# Machine overrides (CRITICAL)
# -----------------------------------------------------------------------------
# raspberrypi5 MUST come first for linux-raspberrypi BSP resolution
MACHINEOVERRIDES =. "raspberrypi5:"
MACHINEOVERRIDES .= ":rpi5-bsp"

# -----------------------------------------------------------------------------
# Console
# -----------------------------------------------------------------------------
ENABLE_UART = "1"
SERIAL_CONSOLES = "115200;ttyAMA0"
APPEND += "console=ttyAMA0,115200 console=tty1"
APPEND += "earlycon=pl011,mmio32,0x107c0000"

# -----------------------------------------------------------------------------
# Image types
# -----------------------------------------------------------------------------
IMAGE_FSTYPES += "wic wic.bmap"

# -----------------------------------------------------------------------------
# Kernel
# -----------------------------------------------------------------------------
PREFERRED_PROVIDER_virtual/kernel = "linux-raspberrypi"

# -----------------------------------------------------------------------------
# Wi-Fi
# -----------------------------------------------------------------------------
ENABLE_WIFI = "1"
MACHINE_EXTRA_RRECOMMENDS += "linux-firmware-rpidistro-bcm43456"
MACHINE_FEATURES:append = " wifi bluetooth"
```
